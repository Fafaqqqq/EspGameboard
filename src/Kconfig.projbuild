## src/Kconfig.projbuild
```kconfig
menu "Example Configuration"
 
    config PIN_NUM_MOSI
        int "MOSI pin"
        range 0 48
        default 23
        help
            MOSI pin
 
    config PIN_NUM_MISO
        int "MISO pin"
        range 0 48
        default 25
        help
            MISO pin
 
    config PIN_NUM_CLK
        int "CLK pin"
        range 0 48
        default 19
        help
            CLK pin
 
    config PIN_NUM_CS
        int "CS pin"
        range 0 48
        default 22
        help
            CS pin
 
    config PIN_NUM_DC
        int "DC pin"
        range 0 48
        default 21
        help
            DC pin
 
    config PIN_NUM_BCKL
        int "BCKL pin"
        range 0 48
        default 5
        help
            BCKL pin
 
    config PIN_NUM_RST
        int "RST pin"
        range 0 48
        default 18
        help
            RST pin
 
    config ESP_WIFI_SSID
            string "WiFi SSID"
            default "myssid"
            help
                SSID (network name) for the example to connect to.

        config ESP_WIFI_PASSWORD
            string "WiFi Password"
            default "mypassword"
            help
                WiFi password (WPA or WPA2) for the example to use.
        config ESP_WIFI_CHANNEL
            int "WiFi Channel"
            range 1 13
            default 1
            help
                WiFi channel (network channel) for the example to use.

        config ESP_MAX_STA_CONN
            int "Maximal STA connections"
            default 4
            help
                Max number of the STA connects to AP.

endmenu
```
